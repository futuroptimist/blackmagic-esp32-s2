## components/wolfssh_spike/Kconfig
```kconfig
menu "wolfSSH feasibility spike"

    config EXPERIMENTAL_WOLFSSH_SERVER
        bool "Enable experimental wolfSSH server (feasibility spike)"
        default n
        help
            Builds and starts a minimal, single-session SSH server on TCP
            port 2222, authenticating exactly one public key and accepting
            exactly one exec command ("ping" -> "pong"). Everything else
            (shell, PTY, subsystems, SFTP/SCP, forwarding, password auth) is
            rejected. This is an experimental feasibility spike, not a
            production feature -- see docs/design/ssh-feasibility-spike.md.

            When disabled (the default), wolfSSL/wolfSSH are not compiled or
            linked, and no key files are required to build.

            When enabled, the build requires one environment variable
            pointing at an externally-supplied key file:
              WOLFSSH_SPIKE_AUTHORIZED_KEY_PATH  (ECDSA P-256 authorized public key)
            See scripts/gen_ssh_spike_keys.sh to generate a disposable
            developer key outside the repository. The host key is
            generated on-device on first boot and persisted in NVS -- no
            build-time host key input.

endmenu
```
